## meta-asteroid-fixes/conf/layer.conf
```bitbake
BBPATH =. "${LAYERDIR}:"
BBFILES += "${LAYERDIR}/recipes*/*/*.bb \
            ${LAYERDIR}/recipes*/*/*.bbappend"
BBFILE_COLLECTIONS += "meta-asteroid-fixes"
BBFILE_PATTERN_meta-asteroid-fixes := "^${LAYERDIR}/"
BBFILE_PRIORITY_meta-asteroid-fixes = "10"
LAYERSERIES_COMPAT_meta-asteroid-fixes = "walnascar"
```
